## conf/layer.conf
```bitbake
# We have a conf and classes directory, append to BBPATH
BBPATH .= ":${LAYERDIR}"

# We have a recipes directory, add to BBFILES
BBFILES += "${LAYERDIR}/recipes*/*/*.bb ${LAYERDIR}/recipes*/*/*.bbappend"

BBFILE_COLLECTIONS += "meta-foundationos-sunxi"
BBFILE_PATTERN_meta-foundationos-sunxi := "^${LAYERDIR}/"
BBFILE_PRIORITY_meta-foundationos-sunxi = "10"

# This should only be incremented on significant changes that will
# cause compatibility issues with other layers
LAYERVERSION_meta-foundationos-sunxi = "1"

LAYERDEPENDS_meta-foundationos-sunxi = "core openembedded-layer meta-sunxi"

LAYERSERIES_COMPAT_meta-foundationos-sunxi = "thud warrior"
```

## conf/machine/foundationos-all-h3-cc.conf
```bitbake
#@TYPE: Machine
#@NAME: foundationos-all-h3-cc
#@DESCRIPTION: Machine configuration for the orange-pi-zero-plus2, base on Allwinner H5 CPU


require conf/machine/include/sun8i.inc

PREFERRED_PROVIDER_virtual/kernel ?= "linux-yocto"

PREFERRED_VERSION_u-boot = "v2018.09%"
PREFERRED_VERSION_linux-mainline = "5.0.19"

KERNEL_IMAGETYPE = "fitImage"
KERNEL_CLASSES += "kernel-fitimage"
KERNEL_DEVICETREE = "sun8i-h3-libretech-all-h3-cc.dtb"

IMAGE_FSTYPES = " wic wic.bmap"
IMAGE_BOOT_FILES_append = "fitImage"

UBOOT_MACHINE = "foundationos_libretech_all_h3_cc_h2_plus_defconfig"

SERIAL_CONSOLE = "115200 ttyS0"

FOUNDATIONOS_PTABLE_TYPE="gpt"

#Match alignment to sector size defined in wic
FOUNDATIONOS_PARTITION_ALIGNMENT_KB="512"

#Reserved space for the bootloader.
#uboot binary must be located at offset 128k
FOUNDATIONOS_ALLH3CC_RESERVED_PART_SIZE="111k"

#Size of uboot partition.
FOUNDATIONOS_ALLH3CC_UBOOT_SPL_PART_SIZE="32k"

#Size of uboot partition.
FOUNDATIONOS_ALLH3CC_UBOOT_PART_SIZE="1024k"

#Kernel partition size.
FOUNDATIONOS_ALLH3CC_KERNEL_PART_SIZE="30M"

FOUNDATIONOS_BOOT_PART_NUMBER="3"
FOUNDATIONOS_VAR_PART_NUMBER="7"

WKS_FILE = "foundationos-allh3cc.wks.in"
### wic default support
WKS_FILE_DEPENDS ?= " \
    virtual/bootloader \
    e2fsprogs-native \
    bmap-tools-native \
"
WICVARS_append = " \
    FOUNDATIONOS_ALLH3CC_RESERVED_PART_SIZE \
    FOUNDATIONOS_ALLH3CC_UBOOT_SPL_PART_SIZE \
    FOUNDATIONOS_ALLH3CC_UBOOT_PART_SIZE \
    FOUNDATIONOS_ALLH3CC_KERNEL_PART_SIZE \
"
```
